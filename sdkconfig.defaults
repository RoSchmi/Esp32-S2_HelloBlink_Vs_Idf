## sdkconfig.defaults
```kconfig
CONFIG_TINYUSB_ENABLED=y
CONFIG_TINYUSB_CDC_ENABLED=y
CONFIG_USB_CDC_ACM_ENABLED=y
CONFIG_ESP_CONSOLE_USB_CDC=y
CONFIG_ESP32S2_KEEP_USB_ALIVE=y
```

## sdkconfig.defaults.esp32s2
```kconfig
# Are not propagated to sdkconfig (are no)
CONFIG_BLINK_LED_STRIP=y
CONFIG_BLINK_GPIO=18
```
